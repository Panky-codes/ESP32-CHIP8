## components/CHIP8/Kconfig
```kconfig
menu "SPIFFS INFO"

config SPIFFS_BASE_ADDR
    int "SPIFFS Base address"
    range 1048576 33546240
    default 0x210000
    help
	Starting address of the SPIFFS area in ESP32 Flash

config SPIFFS_SIZE
    int "SPIFFS Size in bytes"
    range 262144 2097152
    default 1048576

config SPIFFS_LOG_BLOCK_SIZE
    int "SPIFFS Logical block size"
    range 4096 65536
    default 8192

config SPIFFS_LOG_PAGE_SIZE
    int "SPIFFS Logical page size"
    range 256 2048
    default 256
    help
    Set it to the physical page size og the used SPI Flash chip.
config SPIFFS_BASE_DIR
    string "SPIFFS base directory name"
    default "/spiffs"
    help
        This name will be used to mount the SPIFFS

endmenu
```
